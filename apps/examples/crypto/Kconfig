## apps/examples/crypto/Kconfig
```kconfig
#
# For a description of the syntax of this configuration file,
# see misc/tools/kconfig-language.txt.
#

config EXAMPLES_CRYPTO
	bool "Cryptographic API tool"
	default n
	---help---
		Enable the Crypto tool

if EXAMPLES_CRYPTO

config EXAMPLES_CRYPTO_PROGNAME
	string "Program name"
	default "cryptool"
	depends on BUILD_KERNEL
	---help---
		This is the name of the program that will be use when the NSH ELF
		program is installed.

endif
```

## nuttx/crypto/Kconfig
```kconfig
#
# For a description of the syntax of this configuration file,
# see misc/tools/kconfig-language.txt.
#

config CRYPTO
  bool "Crypto API support"
  default n
  ---help---
    Enable or disable Crypto API features

if CRYPTO

config CRYPTO_CONTEXT_CACHE
  bool "Enable Context Cache"
  default n
  ---help---
    The context cache is used to improve performances

if CRYPTO_CONTEXT_CACHE

config CRYPTO_CONTEXT_CACHE_COUNT
  int "Context Cache entries"
  default 1
  ---help---
    The correct value here is the number of expected concurrently accessed contexts.

endif

endif
```
